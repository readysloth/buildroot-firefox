## package/firefox/Config.in
```kconfig
config BR2_PACKAGE_FIREFOX
	bool "firefox"
	# buildtime dependencies
	# runtime dependencies
	select BR2_PACKAGE_ALSA_LIB
	select BR2_PACKAGE_FONTCONFIG
	select BR2_PACKAGE_FREETYPE
	select BR2_PACKAGE_DBUS
	select BR2_PACKAGE_CAIRO
	select BR2_PACKAGE_GDK_PIXBUF
	select BR2_PACKAGE_LIBGTK3
	select BR2_PACKAGE_XLIB_LIBX11
	select BR2_PACKAGE_XLIB_LIBXCOMPOSITE
	select BR2_PACKAGE_LIBXCB
	select BR2_PACKAGE_PANGO
	select BR2_PACKAGE_XSERVER_XORG_SERVER
	help
		Firefox Web Browser

		https://www.mozilla.com/firefox
```
